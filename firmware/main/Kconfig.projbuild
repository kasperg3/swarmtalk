## firmware/main/Kconfig.projbuild
```kconfig
menu "Communication Firmware Configuration"

    config CONFIG_ESP_CONSOLE_SECONDARY_NONE
        string "Console secondary output None"
        default y
        help
            Disable or enable the secondary output of the console as jtag.

endmenu
```
